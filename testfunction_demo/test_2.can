/*@!Encoding:936*/
testfunction test_01()
{
  write("***************XML调用了 testfunction test_01***************");
}

testfunction test_02(int s)
{
  write("***************XML调用了 testfunction test_02 ，接收参数：%d***************",s);
}

testfunction test_03(char s[])
{
  write("***************XML调用了 testfunction test_03 ，接收参数：%s***************",s);
}

testcase TC_0001()
{
  
}

